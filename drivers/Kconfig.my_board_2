## drivers/Kconfig.my_board_2
```kconfig
config UART_MY_BOARD_2
	bool "CC32XX UART driver"
	default y
	depends on DT_HAS_CUSTOM_MY_BOARD_2_UART_ENABLED
	select SERIAL_HAS_DRIVER
	select SERIAL_SUPPORT_INTERRUPT
	help
	  This option enables the uart
```

## my_board_2/Kconfig.my_board_2
```kconfig
#
# Copyright 2022 Huawei France Technologies SASU
# SPDX-License-Identifier: Apache-2.0
#

config BOARD_MY_BOARD_2
	select SOC_MY_SOC
	
```

## my_board_2/my_board_2_defconfig
```kconfig
# SPDX-License-Identifier: Apache-2.0


CONFIG_SYS_CLOCK_HW_CYCLES_PER_SEC=48000000
CONFIG_SYS_CLOCK_EXISTS=y

# Enable UART driver
CONFIG_SERIAL=y
```

## my_soc/Kconfig.defconfig
```kconfig
if SOC_MY_SOC

config NUM_IRQS
	default 178
	
config SYS_CLOCK_HW_CYCLES_PER_SEC
	default 48000000

endif #MY_SOC
```

## my_test/add/testcase.yaml
```yaml
common:
  tags: ztest
  harness: console
  build_only: true
  harness_config:
    type: ztest
tests:
  mytest.add:
    platform_allow:
      - native_posix
      - native_sim
      - qemu_x86
    integration_platforms:
      - native_sim
```
